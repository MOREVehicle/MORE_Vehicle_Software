VERSION "1.0"

NS_ :

BS_:

BU_: STEERING_BOX

BO_ 25 STEERING_BOX_MESSAGE: 8 STEERING_BOX
     SG_ GATE_DRIVE_FAULT_FLAG : 0|1@0+ (1,0) [0|1] "" RECEIVER_NODE
     SG_ OVERTEMP_FLAG         : 1|1@0+ (1,0) [0|1] "" RECEIVER_NODE
     SG_ TEMPERATURE           : 2|12@0- (0.1,0) [-40|125] "°C" RECEIVER_NODE
     SG_ ANGLE                 : 14|16@0- (1,0) [-780|780] "°" RECEIVER_NODE
     SG_ ANGLE_SPEED           : 30|10@0+ (1,0) [0|1016] "°/s" RECEIVER_NODE
     SG_ CURRENT               : 40|8@0- (1,0) [-80|80] "A" RECEIVER_NODE

CM_ BO_ 025 "The ID is random for now and we weren't sure who would receive the parts of the data to split it so we just put everything in one message";
CM_ SG_ 025 TEMPERATURE "IDK the receiver node";
